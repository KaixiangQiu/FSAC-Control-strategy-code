/******************************************************************************
* ASAP2 file: finalcode.a2l
* Code generation for model "finalcode".
* Model version : 1.247
* Simulink Coder version : 9.3 (R2020a) 18-Nov-2019
* C source code generated on : Thu Oct 17 21:55:11 2024
* Target selection: ec5744.tlc
* Embedded hardware selection: Freescale MPC5500
* Code generation objectives: Unspecified
* Validation result: Not run
* (add additional file header information here)
******************************************************************************/ ASAP2_VERSION 1 31
/* Version 1.31 */
/begin PROJECT ECUCoderProject "ECUCoder Project"
/begin HEADER "Header Comments go here" /end HEADER
/begin MODULE ModuleName "Module Comment Goes Here"
/begin MOD_PAR "MOD PAR Comment Goes Here" /end MOD_PAR
/begin MOD_COMMON "Mod Common Comment Here" BYTE_ORDER MSB_FIRST /end MOD_COMMON
/begin RECORD_LAYOUT Scalar_BOOLEAN FNC_VALUES 1 UBYTE COLUMN_DIR DIRECT /end RECORD_LAYOUT
/begin RECORD_LAYOUT Scalar_UBYTE FNC_VALUES 1 UBYTE COLUMN_DIR DIRECT /end RECORD_LAYOUT
/begin RECORD_LAYOUT Scalar_BYTE FNC_VALUES 1 SBYTE COLUMN_DIR DIRECT /end RECORD_LAYOUT
/begin RECORD_LAYOUT Scalar_UWORD FNC_VALUES 1 UWORD COLUMN_DIR DIRECT /end RECORD_LAYOUT
/begin RECORD_LAYOUT Scalar_SWORD FNC_VALUES 1 SWORD COLUMN_DIR DIRECT /end RECORD_LAYOUT
/begin RECORD_LAYOUT Scalar_ULONG FNC_VALUES 1 ULONG COLUMN_DIR DIRECT /end RECORD_LAYOUT
/begin RECORD_LAYOUT Scalar_LONG FNC_VALUES 1 SLONG COLUMN_DIR DIRECT /end RECORD_LAYOUT
/begin RECORD_LAYOUT Scalar_FLOAT32_IEEE FNC_VALUES 1 FLOAT32_IEEE COLUMN_DIR DIRECT /end RECORD_LAYOUT
/begin RECORD_LAYOUT Scalar_FLOAT64_IEEE FNC_VALUES 1 FLOAT64_IEEE COLUMN_DIR DIRECT /end RECORD_LAYOUT
/begin RECORD_LAYOUT Lookup1D_BOOLEAN FNC_VALUES 1 UBYTE COLUMN_DIR DIRECT /end RECORD_LAYOUT
/begin RECORD_LAYOUT Lookup1D_X_BOOLEAN AXIS_PTS_X 1 UBYTE INDEX_INCR DIRECT /end RECORD_LAYOUT
/begin RECORD_LAYOUT Lookup1D_BYTE FNC_VALUES 1 SBYTE COLUMN_DIR DIRECT /end RECORD_LAYOUT
/begin RECORD_LAYOUT Lookup1D_X_BYTE AXIS_PTS_X 1 SBYTE INDEX_INCR DIRECT /end RECORD_LAYOUT
/begin RECORD_LAYOUT Lookup1D_UBYTE FNC_VALUES 1 UBYTE COLUMN_DIR DIRECT /end RECORD_LAYOUT
/begin RECORD_LAYOUT Lookup1D_X_UBYTE AXIS_PTS_X 1 UBYTE INDEX_INCR DIRECT /end RECORD_LAYOUT
/begin RECORD_LAYOUT Lookup1D_UWORD FNC_VALUES 1 UWORD COLUMN_DIR DIRECT /end RECORD_LAYOUT
/begin RECORD_LAYOUT Lookup1D_X_UWORD AXIS_PTS_X 1 UWORD INDEX_INCR DIRECT /end RECORD_LAYOUT
/begin RECORD_LAYOUT Lookup1D_WORD FNC_VALUES 1 SWORD COLUMN_DIR DIRECT /end RECORD_LAYOUT
/begin RECORD_LAYOUT Lookup1D_X_WORD AXIS_PTS_X 1 SWORD INDEX_INCR DIRECT /end RECORD_LAYOUT
/begin RECORD_LAYOUT Lookup1D_ULONG FNC_VALUES 1 ULONG COLUMN_DIR DIRECT /end RECORD_LAYOUT
/begin RECORD_LAYOUT Lookup1D_X_ULONG AXIS_PTS_X 1 ULONG INDEX_INCR DIRECT /end RECORD_LAYOUT
/begin RECORD_LAYOUT Lookup1D_SLONG FNC_VALUES 1 SLONG COLUMN_DIR DIRECT /end RECORD_LAYOUT
/begin RECORD_LAYOUT Lookup1D_X_LONG AXIS_PTS_X 1 SLONG INDEX_INCR DIRECT /end RECORD_LAYOUT
/begin RECORD_LAYOUT Lookup1D_FLOAT32_IEEE FNC_VALUES 1 FLOAT32_IEEE COLUMN_DIR DIRECT /end RECORD_LAYOUT
/begin RECORD_LAYOUT Lookup1D_X_FLOAT32_IEEE AXIS_PTS_X 1 FLOAT32_IEEE INDEX_INCR DIRECT /end RECORD_LAYOUT
/begin RECORD_LAYOUT Lookup1D_FLOAT64_IEEE FNC_VALUES 1 FLOAT64_IEEE COLUMN_DIR DIRECT /end RECORD_LAYOUT
/begin RECORD_LAYOUT Lookup1D_X_FLOAT64_IEEE AXIS_PTS_X 1 FLOAT64_IEEE INDEX_INCR DIRECT /end RECORD_LAYOUT
/begin RECORD_LAYOUT Lookup2D_BOOLEAN FNC_VALUES 1 UBYTE COLUMN_DIR DIRECT /end RECORD_LAYOUT
/begin RECORD_LAYOUT Lookup2D_X_BOOLEAN AXIS_PTS_X 1 UBYTE INDEX_INCR DIRECT /end RECORD_LAYOUT
/begin RECORD_LAYOUT Lookup2D_UBYTE FNC_VALUES 1 UBYTE COLUMN_DIR DIRECT /end RECORD_LAYOUT
/begin RECORD_LAYOUT Lookup2D_X_UBYTE AXIS_PTS_X 1 UBYTE INDEX_INCR DIRECT /end RECORD_LAYOUT
/begin RECORD_LAYOUT Lookup2D_BYTE FNC_VALUES 1 SBYTE COLUMN_DIR DIRECT /end RECORD_LAYOUT
/begin RECORD_LAYOUT Lookup2D_X_BYTE AXIS_PTS_X 1 SBYTE INDEX_INCR DIRECT /end RECORD_LAYOUT
/begin RECORD_LAYOUT Lookup2D_UWORD FNC_VALUES 1 UWORD COLUMN_DIR DIRECT /end RECORD_LAYOUT
/begin RECORD_LAYOUT Lookup2D_X_UWORD AXIS_PTS_X 1 UWORD INDEX_INCR DIRECT /end RECORD_LAYOUT
/begin RECORD_LAYOUT Lookup2D_WORD FNC_VALUES 1 SWORD COLUMN_DIR DIRECT /end RECORD_LAYOUT
/begin RECORD_LAYOUT Lookup2D_X_WORD AXIS_PTS_X 1 SWORD INDEX_INCR DIRECT /end RECORD_LAYOUT
/begin RECORD_LAYOUT Lookup2D_ULONG FNC_VALUES 1 ULONG COLUMN_DIR DIRECT /end RECORD_LAYOUT
/begin RECORD_LAYOUT Lookup2D_X_ULONG AXIS_PTS_X 1 ULONG INDEX_INCR DIRECT /end RECORD_LAYOUT
/begin RECORD_LAYOUT Lookup2D_LONG FNC_VALUES 1 SLONG COLUMN_DIR DIRECT /end RECORD_LAYOUT
/begin RECORD_LAYOUT Lookup2D_X_LONG AXIS_PTS_X 1 SLONG INDEX_INCR DIRECT /end RECORD_LAYOUT
/begin RECORD_LAYOUT Lookup2D_FLOAT32_IEEE FNC_VALUES 1 FLOAT32_IEEE COLUMN_DIR DIRECT /end RECORD_LAYOUT
/begin RECORD_LAYOUT Lookup2D_X_FLOAT32_IEEE AXIS_PTS_X 1 FLOAT32_IEEE INDEX_INCR DIRECT /end RECORD_LAYOUT
/begin RECORD_LAYOUT Lookup2D_FLOAT64_IEEE FNC_VALUES 1 FLOAT64_IEEE COLUMN_DIR DIRECT /end RECORD_LAYOUT
/begin RECORD_LAYOUT Lookup2D_X_FLOAT64_IEEE AXIS_PTS_X 1 FLOAT64_IEEE INDEX_INCR DIRECT /end RECORD_LAYOUT
/begin CHARACTERISTIC P11111 "" VALUE 0x40001300 Scalar_FLOAT64_IEEE 0 finalcode_CM_double -1.7E+308 1.7E+308 /end CHARACTERISTIC
/begin CHARACTERISTIC P22222 "" VALUE 0x40001308 Scalar_FLOAT64_IEEE 0 finalcode_CM_double -1.7E+308 1.7E+308 /end CHARACTERISTIC
/begin CHARACTERISTIC PIDmodel "" VALUE 0x40001310 Scalar_FLOAT64_IEEE 0 finalcode_CM_double -1.7E+308 1.7E+308 /end CHARACTERISTIC
/begin CHARACTERISTIC PPPP "" VALUE 0x40001318 Scalar_FLOAT64_IEEE 0 finalcode_CM_double -1.7E+308 1.7E+308 /end CHARACTERISTIC
/begin CHARACTERISTIC TTTTTyouren "" VALUE 0x40001320 Scalar_FLOAT64_IEEE 0 finalcode_CM_double -1.7E+308 1.7E+308 /end CHARACTERISTIC
/begin CHARACTERISTIC T_add "" VALUE 0x40001328 Scalar_FLOAT64_IEEE 0 finalcode_CM_double -1.7E+308 1.7E+308 /end CHARACTERISTIC
/begin CHARACTERISTIC T_del "" VALUE 0x40001330 Scalar_FLOAT64_IEEE 0 finalcode_CM_double -1.7E+308 1.7E+308 /end CHARACTERISTIC
/begin CHARACTERISTIC acc_calmax1 "" VALUE 0x40001338 Scalar_FLOAT64_IEEE 0 finalcode_CM_double -1.7E+308 1.7E+308 /end CHARACTERISTIC
/begin CHARACTERISTIC acc_calmax2 "" VALUE 0x40001340 Scalar_FLOAT64_IEEE 0 finalcode_CM_double -1.7E+308 1.7E+308 /end CHARACTERISTIC
/begin CHARACTERISTIC acc_calmin1 "" VALUE 0x40001348 Scalar_FLOAT64_IEEE 0 finalcode_CM_double -1.7E+308 1.7E+308 /end CHARACTERISTIC
/begin CHARACTERISTIC acc_calmin2 "" VALUE 0x40001350 Scalar_FLOAT64_IEEE 0 finalcode_CM_double -1.7E+308 1.7E+308 /end CHARACTERISTIC
/begin CHARACTERISTIC akemancanshu "" VALUE @MemoryAddress@akemancanshu@ Scalar_FLOAT64_IEEE 0 finalcode_CM_double -1.7E+308 1.7E+308 /end CHARACTERISTIC
/begin CHARACTERISTIC angle_middle "" VALUE 0x40001358 Scalar_FLOAT64_IEEE 0 finalcode_CM_double -1.7E+308 1.7E+308 /end CHARACTERISTIC
/begin CHARACTERISTIC bre "" VALUE 0x40001360 Scalar_FLOAT64_IEEE 0 finalcode_CM_double -1.7E+308 1.7E+308 /end CHARACTERISTIC
/begin CHARACTERISTIC chasuniujvvvv_hou "" VALUE 0x40001368 Scalar_FLOAT64_IEEE 0 finalcode_CM_double -1.7E+308 1.7E+308 /end CHARACTERISTIC
/begin CHARACTERISTIC chasuniujvvvv_qian "" VALUE 0x40001370 Scalar_FLOAT64_IEEE 0 finalcode_CM_double -1.7E+308 1.7E+308 /end CHARACTERISTIC
/begin CHARACTERISTIC chasuuuu "" VALUE 0x40001378 Scalar_FLOAT64_IEEE 0 finalcode_CM_double -1.7E+308 1.7E+308 /end CHARACTERISTIC
/begin CHARACTERISTIC kd "" VALUE 0x40001380 Scalar_FLOAT64_IEEE 0 finalcode_CM_double -1.7E+308 1.7E+308 /end CHARACTERISTIC
/begin CHARACTERISTIC kddd "" VALUE 0x40001388 Scalar_FLOAT64_IEEE 0 finalcode_CM_double -1.7E+308 1.7E+308 /end CHARACTERISTIC
/begin CHARACTERISTIC ki "" VALUE 0x40001390 Scalar_FLOAT64_IEEE 0 finalcode_CM_double -1.7E+308 1.7E+308 /end CHARACTERISTIC
/begin CHARACTERISTIC kiii "" VALUE 0x40001398 Scalar_FLOAT64_IEEE 0 finalcode_CM_double -1.7E+308 1.7E+308 /end CHARACTERISTIC
/begin CHARACTERISTIC kp "" VALUE 0x400013a0 Scalar_FLOAT64_IEEE 0 finalcode_CM_double -1.7E+308 1.7E+308 /end CHARACTERISTIC
/begin CHARACTERISTIC kppp "" VALUE 0x400013a8 Scalar_FLOAT64_IEEE 0 finalcode_CM_double -1.7E+308 1.7E+308 /end CHARACTERISTIC
/begin CHARACTERISTIC slip "" VALUE 0x400013b0 Scalar_FLOAT64_IEEE 0 finalcode_CM_double -1.7E+308 1.7E+308 /end CHARACTERISTIC
/begin CHARACTERISTIC slip_big "" VALUE 0x400013b8 Scalar_FLOAT64_IEEE 0 finalcode_CM_double -1.7E+308 1.7E+308 /end CHARACTERISTIC
/begin CHARACTERISTIC slip_little "" VALUE 0x400013c0 Scalar_FLOAT64_IEEE 0 finalcode_CM_double -1.7E+308 1.7E+308 /end CHARACTERISTIC
/begin CHARACTERISTIC slipmodel "" VALUE 0x400013c8 Scalar_FLOAT64_IEEE 0 finalcode_CM_double -1.7E+308 1.7E+308 /end CHARACTERISTIC
/begin CHARACTERISTIC vvvv "" VALUE 0x400013d0 Scalar_FLOAT64_IEEE 0 finalcode_CM_double -1.7E+308 1.7E+308 /end CHARACTERISTIC
/begin CHARACTERISTIC zhiling "" VALUE 0x400013d8 Scalar_FLOAT64_IEEE 0 finalcode_CM_double -1.7E+308 1.7E+308 /end CHARACTERISTIC
/begin CHARACTERISTIC leftmax "" VALUE 0x400013e0 Scalar_FLOAT32_IEEE 0 finalcode_CM_single -3.4E+38 3.4E+38 /end CHARACTERISTIC
/begin CHARACTERISTIC rightmax "" VALUE 0x400013e4 Scalar_FLOAT32_IEEE 0 finalcode_CM_single -3.4E+38 3.4E+38 /end CHARACTERISTIC
/begin MEASUREMENT msk "" FLOAT64_IEEE finalcode_CM_double 0 0 -1.7E+308 1.7E+308 ECU_ADDRESS 0x40001140 /end MEASUREMENT
/begin MEASUREMENT msd "" FLOAT64_IEEE finalcode_CM_double 0 0 -1.7E+308 1.7E+308 ECU_ADDRESS 0x40001228 /end MEASUREMENT
/begin MEASUREMENT v_youren "" FLOAT64_IEEE finalcode_CM_double 0 0 -1.7E+308 1.7E+308 ECU_ADDRESS 0x400011c8 /end MEASUREMENT
/begin MEASUREMENT guiyi "" FLOAT64_IEEE finalcode_CM_double 0 0 -1.7E+308 1.7E+308 ECU_ADDRESS 0x40001220 /end MEASUREMENT
/begin MEASUREMENT bre_result "" FLOAT64_IEEE finalcode_CM_double 0 0 -1.7E+308 1.7E+308 ECU_ADDRESS 0x40001260 /end MEASUREMENT
/begin MEASUREMENT acc_result2 "" FLOAT64_IEEE finalcode_CM_double 0 0 -1.7E+308 1.7E+308 ECU_ADDRESS 0x40001238 /end MEASUREMENT
/begin MEASUREMENT acc_result1 "" FLOAT64_IEEE finalcode_CM_double 0 0 -1.7E+308 1.7E+308 ECU_ADDRESS 0x40001168 /end MEASUREMENT
/begin MEASUREMENT tttttttt "" FLOAT64_IEEE finalcode_CM_double 0 0 -1.7E+308 1.7E+308 ECU_ADDRESS 0x40001150 /end MEASUREMENT
/begin MEASUREMENT NT1 "" FLOAT64_IEEE finalcode_CM_double 0 0 -1.7E+308 1.7E+308 ECU_ADDRESS 0x40001288 /end MEASUREMENT
/begin MEASUREMENT NT2 "" FLOAT64_IEEE finalcode_CM_double 0 0 -1.7E+308 1.7E+308 ECU_ADDRESS 0x400011e8 /end MEASUREMENT
/begin MEASUREMENT steer_toworkstation "" FLOAT64_IEEE finalcode_CM_double 0 0 -1.7E+308 1.7E+308 ECU_ADDRESS 0x40001270 /end MEASUREMENT
/begin MEASUREMENT d "" FLOAT64_IEEE finalcode_CM_double 0 0 -1.7E+308 1.7E+308 ECU_ADDRESS 0x40001278 /end MEASUREMENT
/begin MEASUREMENT zhuanjiaoshuzhi "" FLOAT64_IEEE finalcode_CM_double 0 0 -1.7E+308 1.7E+308 ECU_ADDRESS 0x400011a0 /end MEASUREMENT
/begin MEASUREMENT zhuanxiang_1 "" FLOAT64_IEEE finalcode_CM_double 0 0 -1.7E+308 1.7E+308 ECU_ADDRESS 0x40001258 /end MEASUREMENT
/begin MEASUREMENT zhuanxiang_0 "" FLOAT64_IEEE finalcode_CM_double 0 0 -1.7E+308 1.7E+308 ECU_ADDRESS 0x400012a0 /end MEASUREMENT
/begin MEASUREMENT zhuanxiang "" FLOAT64_IEEE finalcode_CM_double 0 0 -1.7E+308 1.7E+308 ECU_ADDRESS 0x400012e8 /end MEASUREMENT
/begin MEASUREMENT NT3 "" FLOAT64_IEEE finalcode_CM_double 0 0 -1.7E+308 1.7E+308 ECU_ADDRESS 0x400012b0 /end MEASUREMENT
/begin MEASUREMENT NT_zuohou "" FLOAT64_IEEE finalcode_CM_double 0 0 -1.7E+308 1.7E+308 ECU_ADDRESS 0x400012c0 /end MEASUREMENT
/begin MEASUREMENT T_zuohou "" FLOAT64_IEEE finalcode_CM_double 0 0 -1.7E+308 1.7E+308 ECU_ADDRESS 0x40001200 /end MEASUREMENT
/begin MEASUREMENT NT_youhou "" FLOAT64_IEEE finalcode_CM_double 0 0 -1.7E+308 1.7E+308 ECU_ADDRESS 0x40001188 /end MEASUREMENT
/begin MEASUREMENT T_youhou "" FLOAT64_IEEE finalcode_CM_double 0 0 -1.7E+308 1.7E+308 ECU_ADDRESS 0x40001240 /end MEASUREMENT
/begin MEASUREMENT NT_youqian "" FLOAT64_IEEE finalcode_CM_double 0 0 -1.7E+308 1.7E+308 ECU_ADDRESS 0x40001160 /end MEASUREMENT
/begin MEASUREMENT T_youqian "" FLOAT64_IEEE finalcode_CM_double 0 0 -1.7E+308 1.7E+308 ECU_ADDRESS 0x40001180 /end MEASUREMENT
/begin MEASUREMENT NT_zuoqian "" FLOAT64_IEEE finalcode_CM_double 0 0 -1.7E+308 1.7E+308 ECU_ADDRESS 0x400011e0 /end MEASUREMENT
/begin MEASUREMENT T_zuoqian "" FLOAT64_IEEE finalcode_CM_double 0 0 -1.7E+308 1.7E+308 ECU_ADDRESS 0x40001230 /end MEASUREMENT
/begin MEASUREMENT zhuanxiangdianji "" FLOAT64_IEEE finalcode_CM_double 0 0 -1.7E+308 1.7E+308 ECU_ADDRESS 0x40001210 /end MEASUREMENT
/begin MEASUREMENT steer_bianmaqi_origin "" FLOAT64_IEEE finalcode_CM_double 0 0 -1.7E+308 1.7E+308 ECU_ADDRESS 0x400011a8 /end MEASUREMENT
/begin MEASUREMENT steer_bianmaqi "" FLOAT64_IEEE finalcode_CM_double 0 0 -1.7E+308 1.7E+308 ECU_ADDRESS 0x40001280 /end MEASUREMENT
/begin MEASUREMENT steer_workstation "" FLOAT64_IEEE finalcode_CM_double 0 0 -1.7E+308 1.7E+308 ECU_ADDRESS 0x400012c8 /end MEASUREMENT
/begin MEASUREMENT enable_185 "" FLOAT64_IEEE finalcode_CM_double 0 0 -1.7E+308 1.7E+308 ECU_ADDRESS 0x40001178 /end MEASUREMENT
/begin MEASUREMENT enable_185_1 "" FLOAT64_IEEE finalcode_CM_double 0 0 -1.7E+308 1.7E+308 ECU_ADDRESS 0x40001290 /end MEASUREMENT
/begin MEASUREMENT enable_188 "" FLOAT64_IEEE finalcode_CM_double 0 0 -1.7E+308 1.7E+308 ECU_ADDRESS 0x400011c0 /end MEASUREMENT
/begin MEASUREMENT enable_188_1 "" FLOAT64_IEEE finalcode_CM_double 0 0 -1.7E+308 1.7E+308 ECU_ADDRESS 0x40001208 /end MEASUREMENT
/begin MEASUREMENT enable_184 "" FLOAT64_IEEE finalcode_CM_double 0 0 -1.7E+308 1.7E+308 ECU_ADDRESS 0x40001298 /end MEASUREMENT
/begin MEASUREMENT enable_184_1 "" FLOAT64_IEEE finalcode_CM_double 0 0 -1.7E+308 1.7E+308 ECU_ADDRESS 0x400011f8 /end MEASUREMENT
/begin MEASUREMENT enable_189 "" FLOAT64_IEEE finalcode_CM_double 0 0 -1.7E+308 1.7E+308 ECU_ADDRESS 0x40001268 /end MEASUREMENT
/begin MEASUREMENT enable_189_1 "" FLOAT64_IEEE finalcode_CM_double 0 0 -1.7E+308 1.7E+308 ECU_ADDRESS 0x400011f0 /end MEASUREMENT
/begin MEASUREMENT enable "" FLOAT64_IEEE finalcode_CM_double 0 0 -1.7E+308 1.7E+308 ECU_ADDRESS 0x400011d8 /end MEASUREMENT
/begin MEASUREMENT v_zuohou "" FLOAT64_IEEE finalcode_CM_double 0 0 -1.7E+308 1.7E+308 ECU_ADDRESS 0x40001248 /end MEASUREMENT
/begin MEASUREMENT v_youhou "" FLOAT64_IEEE finalcode_CM_double 0 0 -1.7E+308 1.7E+308 ECU_ADDRESS 0x400012d0 /end MEASUREMENT
/begin MEASUREMENT v_youqian "" FLOAT64_IEEE finalcode_CM_double 0 0 -1.7E+308 1.7E+308 ECU_ADDRESS 0x400012d8 /end MEASUREMENT
/begin MEASUREMENT v_zuoqian "" FLOAT64_IEEE finalcode_CM_double 0 0 -1.7E+308 1.7E+308 ECU_ADDRESS 0x40001198 /end MEASUREMENT
/begin MEASUREMENT k "" FLOAT32_IEEE finalcode_CM_single 0 0 -3.4E+38 3.4E+38 ECU_ADDRESS 0x400011b4 /end MEASUREMENT
/begin MEASUREMENT acc_ori_line1 "" UWORD finalcode_CM_uint16 0 0 0 65535 ECU_ADDRESS 0x40001158 /end MEASUREMENT
/begin MEASUREMENT acc_ori_line2 "" UWORD finalcode_CM_uint16 0 0 0 65535 ECU_ADDRESS 0x40001190 /end MEASUREMENT
/begin MEASUREMENT T232 "" UBYTE finalcode_CM_uint8 0 0 0 255 ECU_ADDRESS 0x40001218 /end MEASUREMENT
/begin MEASUREMENT T233 "" UBYTE finalcode_CM_uint8 0 0 0 255 ECU_ADDRESS 0x400012a9 /end MEASUREMENT
/begin MEASUREMENT CANok "" UBYTE finalcode_CM_uint8 0 0 0 255 ECU_ADDRESS 0x40001219 /end MEASUREMENT
/begin MEASUREMENT CANOK_20 "" UBYTE finalcode_CM_uint8 0 0 0 255 ECU_ADDRESS 0x40001250 /end MEASUREMENT
/begin MEASUREMENT CANOK_21 "" UBYTE finalcode_CM_uint8 0 0 0 255 ECU_ADDRESS 0x400011b8 /end MEASUREMENT
/begin MEASUREMENT CANOK_481 "" UBYTE finalcode_CM_uint8 0 0 0 255 ECU_ADDRESS 0x40001139 /end MEASUREMENT
/begin MEASUREMENT CANOK_81 "" UBYTE finalcode_CM_uint8 0 0 0 255 ECU_ADDRESS 0x40001148 /end MEASUREMENT
/begin MEASUREMENT CANOK_283 "" UBYTE finalcode_CM_uint8 0 0 0 255 ECU_ADDRESS 0x400011b1 /end MEASUREMENT
/begin MEASUREMENT CANOK_284 "" UBYTE finalcode_CM_uint8 0 0 0 255 ECU_ADDRESS 0x400012e0 /end MEASUREMENT
/begin MEASUREMENT CANOK_287 "" UBYTE finalcode_CM_uint8 0 0 0 255 ECU_ADDRESS 0x400012a8 /end MEASUREMENT
/begin MEASUREMENT CANOK_288 "" UBYTE finalcode_CM_uint8 0 0 0 255 ECU_ADDRESS 0x40001149 /end MEASUREMENT
/begin MEASUREMENT CANOK_402 "" UBYTE finalcode_CM_uint8 0 0 0 255 ECU_ADDRESS 0x400012e1 /end MEASUREMENT
/begin MEASUREMENT CANok_shucai "" UBYTE finalcode_CM_uint8 0 0 0 255 ECU_ADDRESS 0x400012b8 /end MEASUREMENT
/begin MEASUREMENT CANOK_08 "" UBYTE finalcode_CM_uint8 0 0 0 255 ECU_ADDRESS 0x400011d0 /end MEASUREMENT
/begin MEASUREMENT V184 "" UBYTE finalcode_CM_uint8 0 0 0 255 ECU_ADDRESS 0x400011b0 /end MEASUREMENT
/begin MEASUREMENT V185 "" UBYTE finalcode_CM_uint8 0 0 0 255 ECU_ADDRESS 0x40001192 /end MEASUREMENT
/begin MEASUREMENT V188 "" UBYTE finalcode_CM_uint8 0 0 0 255 ECU_ADDRESS 0x40001138 /end MEASUREMENT
/begin MEASUREMENT V189 "" UBYTE finalcode_CM_uint8 0 0 0 255 ECU_ADDRESS 0x40001170 /end MEASUREMENT
/begin COMPU_METHOD finalcode_CM_double "Q = V" RAT_FUNC "%15.10" "" COEFFS 0 1 0 0 0 1 /end COMPU_METHOD
/begin COMPU_METHOD finalcode_CM_single "Q = V" RAT_FUNC "%8.6" "" COEFFS 0 1 0 0 0 1 /end COMPU_METHOD
/begin COMPU_METHOD finalcode_CM_uint16 "Q = V" RAT_FUNC "%5.0" "" COEFFS 0 1 0 0 0 1 /end COMPU_METHOD
/begin COMPU_METHOD finalcode_CM_uint8 "Q = V" RAT_FUNC "%3.0" "" COEFFS 0 1 0 0 0 1 /end COMPU_METHOD
/begin GROUP finalcode "finalcode" /* Root */ ROOT /begin SUB_GROUP Root_Subsystem Root___TX Root_______ /end SUB_GROUP /end GROUP
/begin GROUP Root_Subsystem "finalcode/Subsystem" /begin SUB_GROUP S2_Rx S2_Tx S2_run /end SUB_GROUP /end GROUP
/begin GROUP Root___TX "finalcode/无人TX" /begin SUB_GROUP S3_Toworkstation /end SUB_GROUP /end GROUP
/begin GROUP Root_______ "finalcode/转向自动标定" /begin SUB_GROUP S4_______ /end SUB_GROUP /end GROUP
/begin GROUP S2_Rx "finalcode/Subsystem/Rx"
 /begin SUB_GROUP S26_283_285__ S26_284_286__ S26_287_289__ S26_288_290__ S26____ S26_____ S26_____receive___ S26_ebs S26_lcu__receive S26_shucai_receive /end SUB_GROUP
/end GROUP
/begin GROUP S2_Tx "finalcode/Subsystem/Tx" /begin SUB_GROUP S27_Subsystem S27_TX___ S27___ /end SUB_GROUP /begin REF_MEASUREMENT v_youren /end REF_MEASUREMENT /end GROUP
/begin GROUP S2_run "finalcode/Subsystem/run" /begin SUB_GROUP S28_analog_input /end SUB_GROUP /end GROUP
/begin GROUP S3_Toworkstation "finalcode/无人TX/Toworkstation" /begin SUB_GROUP S257_toworkstation /end SUB_GROUP /end GROUP
/begin GROUP S4_______ "finalcode/转向自动标定/转向自动标定" /begin SUB_GROUP S268_Subsystem /end SUB_GROUP /end GROUP
/begin GROUP S26_283_285__ "finalcode/Subsystem/Rx/283 285左前" /begin SUB_GROUP S31_Subsystem2 /end SUB_GROUP /begin REF_MEASUREMENT CANOK_283 /end REF_MEASUREMENT /end GROUP
/begin GROUP S26_284_286__ "finalcode/Subsystem/Rx/284 286右前" /begin SUB_GROUP S32_Subsystem2 /end SUB_GROUP /begin REF_MEASUREMENT CANOK_284 /end REF_MEASUREMENT /end GROUP
/begin GROUP S26_287_289__ "finalcode/Subsystem/Rx/287 289右后" /begin SUB_GROUP S33_Subsystem3 /end SUB_GROUP /begin REF_MEASUREMENT CANOK_287 /end REF_MEASUREMENT /end GROUP
/begin GROUP S26_288_290__ "finalcode/Subsystem/Rx/288 290左后" /begin SUB_GROUP S34_Subsystem2 /end SUB_GROUP /begin REF_MEASUREMENT CANOK_288 /end REF_MEASUREMENT /end GROUP
/begin GROUP S26_ebs "finalcode/Subsystem/Rx/ebs" /begin REF_MEASUREMENT CANOK_402 /end REF_MEASUREMENT /end GROUP
/begin GROUP S26_lcu__receive "finalcode/Subsystem/Rx/lcu——receive" /begin SUB_GROUP S36_Subsystem1 /end SUB_GROUP
 /begin REF_MEASUREMENT CANok enable_184 enable_184_1 enable_185 enable_185_1 enable_188 enable_188_1 enable_189 enable_189_1 /end REF_MEASUREMENT
/end GROUP
/begin GROUP S26_shucai_receive "finalcode/Subsystem/Rx/shucai—receive" /begin REF_MEASUREMENT CANok_shucai /end REF_MEASUREMENT /end GROUP
/begin GROUP S26____ "finalcode/Subsystem/Rx/工作站" /begin SUB_GROUP S38_Subsystem3 /end SUB_GROUP /begin REF_MEASUREMENT CANOK_20 CANOK_21 /end REF_MEASUREMENT /end GROUP
/begin GROUP S26_____receive___ "finalcode/Subsystem/Rx/转向——receive编码器" /begin SUB_GROUP S39_Subsystem3 /end SUB_GROUP /begin REF_MEASUREMENT CANOK_08 /end REF_MEASUREMENT /end GROUP
/begin GROUP S26_____ "finalcode/Subsystem/Rx/转向电机" /begin SUB_GROUP S40_Subsystem3 /end SUB_GROUP /begin REF_MEASUREMENT CANOK_481 CANOK_81 /end REF_MEASUREMENT /end GROUP
/begin GROUP S27_Subsystem "finalcode/Subsystem/Tx/Subsystem" /begin REF_CHARACTERISTIC P11111 P22222 PPPP TTTTTyouren vvvv /end REF_CHARACTERISTIC /end GROUP
/begin GROUP S27_TX___ "finalcode/Subsystem/Tx/TX控制器" /begin SUB_GROUP S116_Subsystem1 S116______ /end SUB_GROUP /end GROUP
/begin GROUP S27___ "finalcode/Subsystem/Tx/转向" /begin SUB_GROUP S118_____ /end SUB_GROUP /begin REF_CHARACTERISTIC angle_middle kd kddd ki kiii kp kppp leftmax rightmax /end REF_CHARACTERISTIC /begin REF_MEASUREMENT zhuanxiang /end REF_MEASUREMENT /end GROUP
/begin GROUP S28_analog_input "finalcode/Subsystem/run/analog_input" /begin SUB_GROUP S216___ S216_______ /end SUB_GROUP /end GROUP
/begin GROUP S257_toworkstation "finalcode/无人TX/Toworkstation/toworkstation" /begin SUB_GROUP S259_toworkstation /end SUB_GROUP /end GROUP
/begin GROUP S268_Subsystem "finalcode/转向自动标定/转向自动标定/Subsystem" /begin REF_MEASUREMENT msd msk /end REF_MEASUREMENT /end GROUP
/begin GROUP S31_Subsystem2 "finalcode/Subsystem/Rx/283 285左前/Subsystem2" /begin SUB_GROUP S42_Subsystem /end SUB_GROUP /end GROUP
/begin GROUP S32_Subsystem2 "finalcode/Subsystem/Rx/284 286右前/Subsystem2" /begin SUB_GROUP S47_Subsystem /end SUB_GROUP /end GROUP
/begin GROUP S33_Subsystem3 "finalcode/Subsystem/Rx/287 289右后/Subsystem3" /begin SUB_GROUP S52_Subsystem /end SUB_GROUP /end GROUP
/begin GROUP S34_Subsystem2 "finalcode/Subsystem/Rx/288 290左后/Subsystem2" /begin SUB_GROUP S57_Subsystem /end SUB_GROUP /end GROUP
/begin GROUP S36_Subsystem1 "finalcode/Subsystem/Rx/lcu——receive/Subsystem1" /begin SUB_GROUP S74_Subsystem /end SUB_GROUP /end GROUP
/begin GROUP S38_Subsystem3 "finalcode/Subsystem/Rx/工作站/Subsystem3" /begin SUB_GROUP S86_Subsystem /end SUB_GROUP /end GROUP
/begin GROUP S39_Subsystem3 "finalcode/Subsystem/Rx/转向——receive编码器/Subsystem3" /begin SUB_GROUP S100_Subsystem /end SUB_GROUP /end GROUP
/begin GROUP S40_Subsystem3 "finalcode/Subsystem/Rx/转向电机/Subsystem3" /begin SUB_GROUP S108_Subsystem /end SUB_GROUP /end GROUP
/begin GROUP S116_Subsystem1 "finalcode/Subsystem/Tx/TX控制器/Subsystem1" /begin REF_CHARACTERISTIC akemancanshu chasuuuu /end REF_CHARACTERISTIC /end GROUP
/begin GROUP S116______ "finalcode/Subsystem/Tx/TX控制器/控制器发送" /begin SUB_GROUP S120_184__1 S120_185__1 S120_188__1 S120_189__1 /end SUB_GROUP /begin REF_CHARACTERISTIC chasuniujvvvv_hou chasuniujvvvv_qian /end REF_CHARACTERISTIC /end GROUP
/begin GROUP S118_____ "finalcode/Subsystem/Tx/转向/转向换算" /begin SUB_GROUP S199_Subsystem /end SUB_GROUP /begin REF_MEASUREMENT zhuanxiang_0 zhuanxiang_1 /end REF_MEASUREMENT /end GROUP
/begin GROUP S216_______ "finalcode/Subsystem/run/analog_input/无人意图转译" /begin SUB_GROUP S225___ /end SUB_GROUP /end GROUP
/begin GROUP S216___ "finalcode/Subsystem/run/analog_input/有人" /begin SUB_GROUP S226_Subsystem1 S226_____ /end SUB_GROUP /end GROUP
/begin GROUP S259_toworkstation "finalcode/无人TX/Toworkstation/toworkstation/toworkstation" /begin REF_MEASUREMENT T232 T233 /end REF_MEASUREMENT /end GROUP
/begin GROUP S42_Subsystem "finalcode/Subsystem/Rx/283 285左前/Subsystem2/Subsystem" /begin REF_MEASUREMENT v_zuoqian /end REF_MEASUREMENT /end GROUP
/begin GROUP S47_Subsystem "finalcode/Subsystem/Rx/284 286右前/Subsystem2/Subsystem" /begin REF_MEASUREMENT v_youqian /end REF_MEASUREMENT /end GROUP
/begin GROUP S52_Subsystem "finalcode/Subsystem/Rx/287 289右后/Subsystem3/Subsystem" /begin REF_MEASUREMENT v_youhou /end REF_MEASUREMENT /end GROUP
/begin GROUP S57_Subsystem "finalcode/Subsystem/Rx/288 290左后/Subsystem2/Subsystem" /begin REF_MEASUREMENT v_zuohou /end REF_MEASUREMENT /end GROUP
/begin GROUP S74_Subsystem "finalcode/Subsystem/Rx/lcu——receive/Subsystem1/Subsystem" /begin REF_MEASUREMENT enable /end REF_MEASUREMENT /end GROUP
/begin GROUP S86_Subsystem "finalcode/Subsystem/Rx/工作站/Subsystem3/Subsystem" /begin REF_MEASUREMENT steer_workstation /end REF_MEASUREMENT /end GROUP
/begin GROUP S100_Subsystem "finalcode/Subsystem/Rx/转向——receive编码器/Subsystem3/Subsystem" /begin REF_MEASUREMENT steer_bianmaqi steer_bianmaqi_origin /end REF_MEASUREMENT /end GROUP
/begin GROUP S108_Subsystem "finalcode/Subsystem/Rx/转向电机/Subsystem3/Subsystem" /begin REF_MEASUREMENT zhuanxiangdianji /end REF_MEASUREMENT /end GROUP
/begin GROUP S120_184__1 "finalcode/Subsystem/Tx/TX控制器/控制器发送/184左前1" /begin SUB_GROUP S131_________ /end SUB_GROUP /begin REF_CHARACTERISTIC slip slip_big slip_little slipmodel /end REF_CHARACTERISTIC /begin REF_MEASUREMENT NT_zuoqian T_zuoqian V184 /end REF_MEASUREMENT /end GROUP
/begin GROUP S120_185__1 "finalcode/Subsystem/Tx/TX控制器/控制器发送/185右前1" /begin REF_CHARACTERISTIC slip slip_big slip_little slipmodel /end REF_CHARACTERISTIC /begin REF_MEASUREMENT NT_youqian T_youqian V185 /end REF_MEASUREMENT /end GROUP
/begin GROUP S120_188__1 "finalcode/Subsystem/Tx/TX控制器/控制器发送/188右后1" /begin REF_CHARACTERISTIC slip slip_big slip_little slipmodel /end REF_CHARACTERISTIC /begin REF_MEASUREMENT NT_youhou T_youhou V188 /end REF_MEASUREMENT /end GROUP
/begin GROUP S120_189__1 "finalcode/Subsystem/Tx/TX控制器/控制器发送/189左后1" /begin REF_CHARACTERISTIC slip slip_big slip_little slipmodel /end REF_CHARACTERISTIC /begin REF_MEASUREMENT NT_zuohou T_zuohou V189 /end REF_MEASUREMENT /end GROUP
/begin GROUP S199_Subsystem "finalcode/Subsystem/Tx/转向/转向换算/Subsystem" /begin REF_CHARACTERISTIC PIDmodel /end REF_CHARACTERISTIC /begin REF_MEASUREMENT d k steer_toworkstation zhuanjiaoshuzhi /end REF_MEASUREMENT /end GROUP
/begin GROUP S225___ "finalcode/Subsystem/run/analog_input/无人意图转译/无人" /begin SUB_GROUP S227_Subsystem1 /end SUB_GROUP /end GROUP
/begin GROUP S226_Subsystem1 "finalcode/Subsystem/run/analog_input/有人/Subsystem1" /begin REF_CHARACTERISTIC T_add T_del zhiling /end REF_CHARACTERISTIC /begin REF_MEASUREMENT tttttttt /end REF_MEASUREMENT /end GROUP
/begin GROUP S226_____ "finalcode/Subsystem/run/analog_input/有人/踏板标定" /begin SUB_GROUP S242_________ArithmeticAverage1 /end SUB_GROUP /begin REF_CHARACTERISTIC acc_calmax1 acc_calmax2 acc_calmin1 acc_calmin2 bre /end REF_CHARACTERISTIC
 /begin REF_MEASUREMENT acc_ori_line1 acc_ori_line2 acc_result1 acc_result2 bre_result /end REF_MEASUREMENT
/end GROUP
/begin GROUP S131_________ "finalcode/Subsystem/Tx/TX控制器/控制器发送/184左前1/能量回收功率限制" /begin REF_MEASUREMENT NT3 /end REF_MEASUREMENT /end GROUP
/begin GROUP S227_Subsystem1 "finalcode/Subsystem/run/analog_input/无人意图转译/无人/Subsystem1" /begin SUB_GROUP S229__________ S229__esc____ /end SUB_GROUP /end GROUP
/begin GROUP S242_________ArithmeticAverage1 "finalcode/Subsystem/run/analog_input/有人/踏板标定/算术平均值滤波 ArithmeticAverage1" /begin REF_MEASUREMENT guiyi /end REF_MEASUREMENT /end GROUP
/begin GROUP S229__________ "finalcode/Subsystem/run/analog_input/无人意图转译/无人/Subsystem1/计算四轮各自制动力" /begin REF_MEASUREMENT NT2 /end REF_MEASUREMENT /end GROUP
/begin GROUP S229__esc____ "finalcode/Subsystem/run/analog_input/无人意图转译/无人/Subsystem1/进esc控制策略" /begin REF_MEASUREMENT NT1 /end REF_MEASUREMENT /end GROUP
/end MODULE
/end PROJECT
/* (add any file trailer comments here) */
/* EOF finalcode.a2l */
